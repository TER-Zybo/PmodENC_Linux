/dts-v1/;
/plugin/;

/ {

    fragment@0 {
        target = <&fpga_full>;
        __overlay__ {
            firmware-name = "enc_wrapper.bit.bin";
        };
    };

    fragment@1 {
        target = <&amba>;
        __overlay__ {
            PetaENC_0: PetaENC@40000000 {
                clock-names = "s_axi_aclk";
                clocks = <&clkc 15>;
                compatible = "generic-uio";
                reg = <0x40000000 0x1000>;
                interrupt-names = "ip2intc_irpt_0";
    		interrupt-parent = <&intc>;
    		interrupts = <0 53 4>;
            };
        };
    };

};
